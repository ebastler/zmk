## app/boards/arm/altar_i_uk/altar_i_uk_defconfig
```kconfig
# Copyright (c) 2023 The ZMK Contributors
# SPDX-License-Identifier: MIT

CONFIG_SOC_SERIES_NRF52X=y
CONFIG_SOC_NRF52840_QIAA=y
CONFIG_BOARD_ALTAR_I_UK=y

# Enable MPU
CONFIG_ARM_MPU=y

# enable GPIO
CONFIG_GPIO=y

CONFIG_USE_DT_CODE_PARTITION=y
CONFIG_BUILD_OUTPUT_UF2=y

CONFIG_MPU_ALLOW_FLASH_WRITE=y
CONFIG_NVS=y
CONFIG_SETTINGS_NVS=y
CONFIG_FLASH=y
CONFIG_FLASH_PAGE_LAYOUT=y
CONFIG_FLASH_MAP=y

# Enable the rotary encoder
CONFIG_EC11=y
CONFIG_EC11_TRIGGER_GLOBAL_THREAD=y

# Enable LEDs
CONFIG_LED=y
CONFIG_LED_PWM=y
CONFIG_PWM=y
CONFIG_PINCTRL=y

# Boost Bluetooth power
CONFIG_BT_CTLR_TX_PWR_PLUS_8=y

# Enable and set deep sleep time
CONFIG_ZMK_SLEEP=y
CONFIG_ZMK_IDLE_SLEEP_TIMEOUT=7200000
CONFIG_ZMK_BATTERY_REPORT_INTERVAL=180

# Windows Battery Reporting Fix
CONFIG_BT_GATT_ENFORCE_SUBSCRIPTION=n
```

## app/boards/arm/sabrina75_rev2/Kconfig.board
```kconfig
# sabrina75 rev2 board configuration

# Copyright (c) 2020 The ZMK Contributors
# SPDX-License-Identifier: MIT

config BOARD_SABRINA75_REV2
	bool "sabrina75 Keyboard"
	depends on SOC_NRF52840_QIAA
```

## app/drivers/sensor/Kconfig
```kconfig
# SPDX-License-Identifier: MIT

rsource "battery/Kconfig"
rsource "ec11/Kconfig"
rsource "max17048/Kconfig"
```
